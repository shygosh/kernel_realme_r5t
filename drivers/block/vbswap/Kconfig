## drivers/block/vbswap/Kconfig
```kconfig
config VBSWAP
	tristate "Fake block device for swap based on vnswap"
	depends on BLOCK && ZSWAP
	default n

config VBSWAP_DISKSIZE
	int "vbswap disksize in gigabytes"
	depends on VBSWAP
	range 1 4
	default 2
```

## drivers/soc/oppo/Kconfig
```kconfig
config OPPO_ARCH_FILE
  bool "for build directory oppo"
  ---help---
  say Y to buid in

config OPPO_COMMON_SOFT
  bool "config oppo common software"
  select OPPO_ARCH_FILE
  help
	define this config to get project verion from sharemem.
	Maybe this value is from CDT or dynamic identify by hardware
	id.

config OPPO_DEVICE_IFNO
  bool "config oppo devinfo"
  select OPPO_ARCH_FILE
  help
	define this config to compile devinfo.c for device register
		.
source "drivers/soc/oppo/oppo_project/Kconfig"
source "drivers/soc/oppo/oppo_devinfo/Kconfig"

#ifdef CONFIG_VENDOR_EDIT
source "drivers/soc/oppo/oppo_shutdown_detect/Kconfig"
source "drivers/soc/oppo/oppo_phoenix/Kconfig"
#endif /* CONFIG_VENDOR_EDIT */

#ifdef CONFIG_VENDOR_EDIT
source "drivers/soc/oppo/oppo_healthinfo/Kconfig"
#endif /* CONFIG_VENDOR_EDIT */

#ifdef CONFIG_VENDOR_EDIT
source "drivers/soc/oppo/oppo_mdmrst/Kconfig"
#endif /* CONFIG_VENDOR_EDIT */

source "drivers/soc/oppo/oppo_kevent_feedback/Kconfig"
#endif /* CONFIG_VENDOR_EDIT */
```

## drivers/soc/oppo/oppo_healthinfo/Kconfig
```kconfig
#ifdef CONFIG_VENDOR_EDIT
config OPPO_HEALTHINFO
bool "config oppo healthinfo"
help
    define this config to init oppo healthinfo.
#endif /* CONFIG_VENDOR_EDIT */
```

## drivers/soc/oppo/oppo_kevent_feedback/Kconfig
```kconfig
#ifdef CONFIG_VENDOR_EDIT
config OPPO_CRITICALLOG
bool "config oppo kevent feedback"
help
    define this config to init oppo kevent feedback driver.
#endif /* CONFIG_VENDOR_EDIT */
```

## drivers/soc/oppo/oppo_shutdown_detect/Kconfig
```kconfig
#ifdef CONFIG_VENDOR_EDIT
config OPPO_SHUTDOWN_DETECT
        bool "OPPO shutdown hang detect"
        default y
        help
            define this config to init oppo oppo_shutdown_detect.
#endif /* CONFIG_VENDOR_EDIT */
```
